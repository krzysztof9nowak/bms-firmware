## boards/arm/bms_olive/Kconfig.board
```kconfig
# Copyright (c) The Libre Solar Project Contributors
# SPDX-License-Identifier: Apache-2.0

config BOARD_BMS_OLIVE
	bool "Libre Solar BMS OLIVE"
    depends on SOC_STM32F103XE
```

## boards/arm/bms_olive/Kconfig.defconfig
```kconfig
# Copyright (c) The Libre Solar Project Contributors
# SPDX-License-Identifier: Apache-2.0

if BOARD_BMS_OLIVE

config BOARD
	default "bms_olive"

config LIBRE_SOLAR_TYPE_ID
	default 2

endif # BOARD_BMS_OLIVE
```

## boards/arm/bms_olive/bms_olive_defconfig
```kconfig
# SPDX-License-Identifier: Apache-2.0

CONFIG_SOC_SERIES_STM32F1X=y
CONFIG_SOC_STM32F103X8=y

CONFIG_CLOCK_CONTROL=y

CONFIG_PINCTRL=y

CONFIG_GPIO=y

CONFIG_SERIAL=y
CONFIG_UART_INTERRUPT_DRIVEN=y

CONFIG_CONSOLE=y
CONFIG_UART_CONSOLE=y

CONFIG_I2C=y

# CONFIG_EEPROM=y
# CONFIG_EEPROM_AT24=y

# CONFIG_CAN=y

# CONFIG_PWR_BUTTON=y
#CONFIG_LED=y

CONFIG_FPU=y

CONFIG_MAIN_STACK_SIZE=4069
```

## dts/bindings/ti,bq769x0.yaml
```yaml
# Copyright (c) The Libre Solar Project Contributors
# SPDX-License-Identifier: Apache-2.0

description: Texas Instruments bq769x0 li-ion and li-phosphate battery monitor

compatible: "ti,bq769x0"

include: i2c-device.yaml

properties:
    alert-gpios:
      type: phandle-array
      required: true
      description: Alert interrupt of bq769x0
    ts1-gpios:
      type: phandle-array
      required: true
      description: TS1 pin of bq769x0, used for wake up
```
